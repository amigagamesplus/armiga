## Config.in
```kconfig
source "$BR2_EXTERNAL_ARMIGA_PATH/package/fastfetch/Config.in"
source "$BR2_EXTERNAL_ARMIGA_PATH/package/btop/Config.in"
source "$BR2_EXTERNAL_ARMIGA_PATH/package/sdl3_ttf/Config.in"
source "$BR2_EXTERNAL_ARMIGA_PATH/package/armiga-launcher/Config.in"
source "$BR2_EXTERNAL_ARMIGA_PATH/package/armiga-splash-text/Config.in"
source "$BR2_EXTERNAL_ARMIGA_PATH/package/sdl3/Config.in"
source "$BR2_EXTERNAL_ARMIGA_PATH/package/kmsdrm-test/Config.in"
source "$BR2_EXTERNAL_ARMIGA_PATH/package/sdl3_image/Config.in"
source "$BR2_EXTERNAL_ARMIGA_PATH/package/sdl-joystick-info/Config.in"
```

## configs/armiga_defconfig
```kconfig
# =============================================================================
# Armiga — Fase 1 defconfig
# Base estable: boot, WiFi/BT, Dropbear SSH, teclado ES, fastfetch
# Target: Anbernic RG40XX H (Allwinner H700 / Cortex-A53 / AArch64)
# Buildroot: 2026.02.x
# =============================================================================

# --- Architecture -----------------------------------------------------------
BR2_aarch64=y
BR2_cortex_a53=y

# --- Toolchain ---------------------------------------------------------------
BR2_TOOLCHAIN_BUILDROOT_GLIBC=y
BR2_TOOLCHAIN_BUILDROOT_CXX=y
BR2_KERNEL_HEADERS_6_6=y

# --- Build options -----------------------------------------------------------
BR2_CCACHE=y
BR2_CCACHE_DIR="$(BR2_EXTERNAL_ARMIGA_PATH)/.buildroot-ccache"

# --- System ------------------------------------------------------------------
BR2_TARGET_GENERIC_HOSTNAME="armiga"
BR2_TARGET_GENERIC_ISSUE="Armiga - Amiga on Anbernic"
BR2_SYSTEM_DHCP="wlan0"
BR2_TARGET_GENERIC_ROOT_PASSWD="armiga"
BR2_TARGET_GENERIC_GETTY_PORT="ttyS0"
BR2_TARGET_GENERIC_GETTY_BAUDRATE_115200=y
BR2_ROOTFS_OVERLAY="$(BR2_EXTERNAL_ARMIGA_PATH)/board/armiga/rootfs_overlay"
BR2_ROOTFS_POST_BUILD_SCRIPT="$(BR2_EXTERNAL_ARMIGA_PATH)/board/armiga/post-build.sh"
BR2_ROOTFS_POST_IMAGE_SCRIPT="$(BR2_EXTERNAL_ARMIGA_PATH)/board/armiga/post-image.sh"
BR2_ROOTFS_POST_SCRIPT_ARGS="$(BR2_EXTERNAL_ARMIGA_PATH)"

# --- Kernel (prebuilt) ------------------------------------------------------
# Kernel se commitea como binario en board/armiga/bootloader/Image
# No compilamos kernel desde Buildroot
BR2_LINUX_KERNEL=n

# --- Bootloader (prebuilt) ---------------------------------------------------
# U-Boot se escribe en raw vía post-image.sh
BR2_TARGET_UBOOT=n

# --- Filesystem --------------------------------------------------------------
BR2_TARGET_ROOTFS_EXT2=y
BR2_TARGET_ROOTFS_EXT2_4=y
BR2_TARGET_ROOTFS_EXT2_SIZE="1100M"
BR2_TARGET_ROOTFS_EXT2_LABEL="system"

# Genimage para layout SD completo
BR2_ROOTFS_POST_IMAGE_SCRIPT="$(BR2_EXTERNAL_ARMIGA_PATH)/board/armiga/post-image.sh"

# --- BusyBox -----------------------------------------------------------------
BR2_PACKAGE_BUSYBOX=y
BR2_PACKAGE_BUSYBOX_SHOW_OTHERS=y

# --- Init (BusyBox) ----------------------------------------------------------
BR2_INIT_BUSYBOX=y

# --- udev (eudev) ------------------------------------------------------------
BR2_ROOTFS_DEVICE_CREATION_DYNAMIC_EUDEV=y

# --- Networking --------------------------------------------------------------
# WiFi
BR2_PACKAGE_WPA_SUPPLICANT=y
BR2_PACKAGE_WPA_SUPPLICANT_NL80211=y
BR2_PACKAGE_WPA_SUPPLICANT_AP_SUPPORT=y
BR2_PACKAGE_WPA_SUPPLICANT_PASSPHRASE=y
BR2_PACKAGE_WIRELESS_TOOLS=y
BR2_PACKAGE_IW=y
BR2_PACKAGE_LINUX_FIRMWARE=y
BR2_PACKAGE_LINUX_FIRMWARE_RTL_87XX=y
BR2_PACKAGE_LINUX_FIRMWARE_RTL_88XX=y

# Bluetooth
BR2_PACKAGE_BLUEZ5_UTILS=y
BR2_PACKAGE_BLUEZ5_UTILS_TOOLS=y
BR2_PACKAGE_BLUEZ5_UTILS_DEPRECATED=y

# SSH
BR2_PACKAGE_DROPBEAR=y
BR2_PACKAGE_DROPBEAR_SMALL=n

# DHCP client (BusyBox udhcpc)
BR2_PACKAGE_BUSYBOX_CONFIG_FRAGMENT_FILES="$(BR2_EXTERNAL_ARMIGA_PATH)/board/armiga/busybox-extras.fragment"

# --- Utilities ---------------------------------------------------------------
BR2_PACKAGE_NANO=y
BR2_PACKAGE_HTOP=y
BR2_PACKAGE_DOSFSTOOLS=y
BR2_PACKAGE_DOSFSTOOLS_MKFS_FAT=y
BR2_PACKAGE_E2FSPROGS=y
BR2_PACKAGE_EXFAT_UTILS=y
BR2_PACKAGE_UTIL_LINUX=y
BR2_PACKAGE_UTIL_LINUX_PARTX=y
BR2_PACKAGE_UTIL_LINUX_BINARIES=y
BR2_PACKAGE_UTIL_LINUX_LIBBLKID=y
BR2_PACKAGE_PARTED=y

# Keyboard / locale
BR2_PACKAGE_KBD=y
BR2_SYSTEM_ENABLE_NLS=y
BR2_PACKAGE_GETTEXT=y

# --- Host tools (para genimage) ----------------------------------------------
BR2_PACKAGE_HOST_DOSFSTOOLS=y
BR2_PACKAGE_HOST_GENIMAGE=y
BR2_PACKAGE_HOST_MTOOLS=y
BR2_PACKAGE_HOST_E2FSPROGS=y

BR2_PACKAGE_LIBDRM=y
BR2_PACKAGE_LIBDRM_PANFROST=y
BR2_PACKAGE_EVTEST=y
BR2_PACKAGE_ACPI=y
BR2_PACKAGE_SDL3=y
BR2_PACKAGE_KMSDRM_TEST=y


BR2_PACKAGE_AMIBERRY=y
BR2_PACKAGE_FLAC=y
BR2_PACKAGE_LIBPNG=y
BR2_PACKAGE_MPG123=y
BR2_PACKAGE_ZSTD=y
BR2_PACKAGE_LIBPCAP=y
BR2_PACKAGE_ENET=y
BR2_PACKAGE_LIBMPEG2=y
BR2_PACKAGE_LIBSERIALPORT=y
BR2_PACKAGE_SDL3_IMAGE=y

BR2_PACKAGE_SDL_JOYSTICK_INFO=y
BR2_PACKAGE_H700_NORMALIZE=y
BR2_PACKAGE_ALSA_UTILS=y
BR2_PACKAGE_ALSA_UTILS_AMIXER=y
BR2_PACKAGE_ALSA_UTILS_APLAY=y
BR2_PACKAGE_BTOP=y
BR2_TARGET_OPTIMIZATION="-O3 -march=armv8-a+crc+simd -fomit-frame-pointer"
BR2_PACKAGE_SDL3_TTF=y
BR2_PACKAGE_ARMIGA_LAUNCHER=y

BR2_PACKAGE_OPENSSL=y
BR2_PACKAGE_LIBCURL=y
BR2_PACKAGE_LIBCURL_CURL=y
BR2_PACKAGE_LIBCURL_OPENSSL=y
```

## package/amiberry/Config.in
```kconfig
config BR2_PACKAGE_AMIBERRY
	bool "amiberry"
	depends on BR2_TOOLCHAIN_HAS_THREADS
	depends on BR2_INSTALL_LIBSTDCPP
	depends on !BR2_STATIC_LIBS
	depends on BR2_aarch64
	select BR2_PACKAGE_SDL3
	select BR2_PACKAGE_FLAC
	select BR2_PACKAGE_LIBPNG
	select BR2_PACKAGE_MPG123
	select BR2_PACKAGE_ZSTD
	select BR2_PACKAGE_LIBCURL
	select BR2_PACKAGE_LIBPCAP
	select BR2_PACKAGE_ENET
	select BR2_PACKAGE_LIBMPEG2
	select BR2_PACKAGE_LIBSERIALPORT
	help
	  Optimized Amiga emulator for ARM with JIT support.
	  Uses SDL3 KMS/DRM backend, OpenGL ES, no X11/Wayland.
	  https://github.com/BlitterStudio/amiberry
```

## package/armiga-launcher/Config.in
```kconfig
config BR2_PACKAGE_ARMIGA_LAUNCHER
	bool "armiga-launcher"
	depends on BR2_PACKAGE_SDL3
	depends on BR2_PACKAGE_SDL3_TTF
	help
	  Launcher principal de Armiga.
	  Menú de juegos, actualización online e información del sistema.
```

## package/armiga-splash-text/Config.in
```kconfig
config BR2_PACKAGE_ARMIGA_SPLASH_TEXT
	bool "armiga-splash-text"
	depends on BR2_PACKAGE_ZLIB
	help
	  Overlay de texto (version, build, fecha) sobre el splash
	  del framebuffer durante el arranque de armiga, usando la
	  fuente Terminus real del sistema (leida en runtime).
```

## package/armiga-splash/Config.in
```kconfig
config BR2_PACKAGE_ARMIGA_SPLASH
	bool "armiga-splash"
	select BR2_PACKAGE_ZLIB
	help
	  Splash de arranque de ARMIGA: imagen (splash.png o splash.jpg),
	  barra de progreso y texto de version/build/fecha sobre /dev/fb0.
```

## package/btop/Config.in
```kconfig
config BR2_PACKAGE_BTOP
	bool "btop"
	depends on BR2_INSTALL_LIBSTDCPP
	depends on BR2_TOOLCHAIN_HAS_THREADS
	depends on BR2_USE_WCHAR
	help
	  Resource monitor that shows usage and stats for
	  processor, memory, disks, network and processes.

	  https://github.com/aristocratos/btop
```

## package/fastfetch/Config.in
```kconfig
config BR2_PACKAGE_FASTFETCH
	bool "fastfetch"
	depends on BR2_TOOLCHAIN_HAS_THREADS
	depends on BR2_INSTALL_LIBSTDCPP
	help
	  Fastfetch is a neofetch-like tool for fetching system
	  information and displaying them in a pretty way.

	  https://github.com/fastfetch-cli/fastfetch
```

## package/kmsdrm-test/Config.in
```kconfig
config BR2_PACKAGE_KMSDRM_TEST
	bool "kmsdrm-test"
	depends on BR2_PACKAGE_SDL3
	help
	  Minimal SDL3 KMS/DRM test (red/green rectangle).
```

## package/sdl-joystick-info/Config.in
```kconfig
config BR2_PACKAGE_SDL_JOYSTICK_INFO
	bool "sdl-joystick-info"
	depends on BR2_PACKAGE_SDL3
	help
	  SDL3 joystick GUID diagnostic tool.
```

## package/sdl3/Config.in
```kconfig
config BR2_PACKAGE_SDL3
	bool "SDL3"
	depends on BR2_TOOLCHAIN_HAS_THREADS
	depends on !BR2_STATIC_LIBS
	select BR2_PACKAGE_ALSA_LIB
	select BR2_PACKAGE_LIBDRM
	help
	  Simple DirectMedia Layer 3 - cross-platform multimedia library.

	  Compiled with KMS/DRM backend for embedded systems.

	  https://www.libsdl.org/
```

## package/sdl3_image/Config.in
```kconfig
config BR2_PACKAGE_SDL3_IMAGE
	bool "sdl3_image"
	depends on BR2_TOOLCHAIN_HAS_THREADS
	depends on !BR2_STATIC_LIBS
	select BR2_PACKAGE_SDL3
	select BR2_PACKAGE_LIBPNG
	help
	  Image loading library for SDL3.
	  https://github.com/libsdl-org/SDL_image
```

## package/sdl3_ttf/Config.in
```kconfig
config BR2_PACKAGE_SDL3_TTF
	bool "sdl3_ttf"
	depends on BR2_PACKAGE_SDL3
	select BR2_PACKAGE_FREETYPE
	help
	  SDL3_ttf is a TrueType font rendering library for SDL3.
	  https://github.com/libsdl-org/SDL_ttf
```
